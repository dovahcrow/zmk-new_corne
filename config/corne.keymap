#include <behaviors/mouse_keys.dtsi>
#include <behaviors.dtsi>
#include <dt-bindings/zmk/bt.h>
#include <dt-bindings/zmk/keys.h>
#include <dt-bindings/zmk/mouse.h>
#include <dt-bindings/zmk/outputs.h>
#include <dt-bindings/zmk/rgb.h>

#include "zmk-helpers/helper.h"
#include <behaviors/num_word.dtsi>

#define AR_1    &kp LC(LA(N1))
#define AR_2    &kp LC(LA(N2))
#define AR_3    &kp LC(LA(N3))
#define AR_4    &kp LC(LA(N4))
#define AR_5    &kp LC(LA(N5))
#define AR_6    &kp LC(LA(N6))
#define AR_7    &kp LC(LA(N7))
#define AR_LW   &kp LC(LA(H))
#define AR_RW   &kp LC(LA(L))
#define AR_FSCR &kp LS(LA(SPACE))
#define AR_ACC  &kp LC(LA(FSLH))
#define AR_TIL  &kp LC(LA(COMMA))
#define OPWD    &kp LG(LA(BSLH))
#define CLPBRD  &kp LG(LS(V))

#define MAC_SLP &kp LG(LC(Q))

#define LG_1 &kp LG(N1)
#define LG_2 &kp LG(N2)
#define LG_3 &kp LG(N3)
#define LG_4 &kp LG(N4)
#define LG_5 &kp LG(N5)

#define PD(key) &kp LA(LC(LS(key)))

/ {
    behaviors {
        mmv {
            acceleration-exponent = <1>;      // 1
            time-to-max-speed-ms = <900>;     // 40
            delay-ms = <0>;                   // 0
        };

        msc {
            acceleration-exponent = <1>;      // 0
            time-to-max-speed-ms = <400>;     // 500
            delay-ms = <0>;                   // 10
        };
    };

    rgb_encoder: rgb_encoder {
        compatible = "zmk,behavior-sensor-rotate";
        label = "RGB_ENCODER";
        #sensor-binding-cells = <0>;
        bindings = <&rgb_ug RGB_BRI>, <&rgb_ug RGB_BRD>;
    };

    scroll_encoder: scroll_encoder {
        compatible = "zmk,behavior-sensor-rotate";
        #sensor-binding-cells = <0>;
        bindings = <&msc SCRL_DOWN>, <&msc SCRL_UP>;

        tap-ms = <30>;
    };

    arrow_encoder: arrow_encoder {
        compatible = "zmk,behavior-sensor-rotate";
        #sensor-binding-cells = <0>;
        bindings = <&kp RIGHT>, <&kp LEFT>;

        tap-ms = <30>;
    };
};

ZMK_COMBO(find  , &kp LG(F)    , 17 18, 0)
ZMK_COMBO(undo  , &kp LG(Z)    , 27 28, 0)
ZMK_COMBO(cut   , &kp LG(X)    , 28 29, 0)
ZMK_COMBO(copy  , &kp LG(C)    , 29 30, 0)
ZMK_COMBO(paste , &kp LG(V)    , 30 31, 0)
ZMK_COMBO(paste2, &kp LS(LG(V)), 30 31, 2)
ZMK_COMBO(caps  , &caps_word   , 17 21, 0, 50)
ZMK_COMBO(sall  , &kp LG(A)    , 14 15, 0, 50)

#define KEYS_L 0  1  2  3  4  5  13 14 15 16 17 18 26 27 28 29 30 31
#define KEYS_R 7  8  9  10 11 12 20 21 22 23 24 25 33 34 35 36 37 38
#define KEYS_T 40 41 42 43 44 45

/* left-hand HRMs */
ZMK_HOLD_TAP(hml,
    flavor = "balanced";
    tapping-term-ms = <280>;
    quick-tap-ms = <175>;                            // repeat on tap-into-hold
    require-prior-idle-ms = <150>;
    bindings = <&kp>, <&kp>;
    hold-trigger-key-positions = <KEYS_R KEYS_T>;
    hold-trigger-on-release;                         // delay positional check until key-release
)

/* right-hand HRMs */
ZMK_HOLD_TAP(hmr,
    flavor = "balanced";
    tapping-term-ms = <280>;
    quick-tap-ms = <350>;                            // repeat on tap-into-hold
    require-prior-idle-ms = <150>;
    bindings = <&kp>, <&kp>;
    hold-trigger-key-positions = <KEYS_L KEYS_T>;
    hold-trigger-on-release;                         // delay positional check until key-release
)

ZMK_HOLD_TAP(la,
    flavor = "balanced";
    tapping-term-ms = <280>;
    quick-tap-ms = <175>;                            // repeat on tap-into-hold
    bindings = <&mo>, <&kp>;
)

ZMK_BEHAVIOR(TMUX1, macro,
    wait-ms = <100>;
    tap-ms = <5>;
    bindings = <&kp LA(M) &kp N1>;
)

ZMK_BEHAVIOR(TMUX2, macro,
    wait-ms = <100>;
    tap-ms = <5>;
    bindings = <&kp LA(M) &kp N2>;
)

ZMK_BEHAVIOR(TMUX3, macro,
    wait-ms = <100>;
    tap-ms = <5>;
    bindings = <&kp LA(M) &kp N3>;
)

ZMK_BEHAVIOR(TMUX4, macro,
    wait-ms = <100>;
    tap-ms = <5>;
    bindings = <&kp LA(M) &kp N4>;
)

ZMK_BEHAVIOR(TMUX5, macro,
    wait-ms = <100>;
    tap-ms = <5>;
    bindings = <&kp LA(M) &kp N5>;
)

ZMK_BEHAVIOR(TMUX6, macro,
    wait-ms = <100>;
    tap-ms = <5>;
    bindings = <&kp LA(M) &kp N6>;
)

ZMK_BEHAVIOR(TMUXC, macro,
    wait-ms = <100>;
    tap-ms = <5>;
    bindings = <&kp LA(M) &kp C>;
)

ZMK_BEHAVIOR(TMUXL, macro,
    wait-ms = <100>;
    tap-ms = <5>;
    bindings = <&kp LA(M) &kp L>;
)

ZMK_BEHAVIOR(TMUXS, macro,
    wait-ms = <100>;
    tap-ms = <5>;
    bindings = <&kp LA(M) &kp LBKT>;
)

ZMK_BEHAVIOR(SNPST_PIC, macro,
    wait-ms = <100>;
    tap-ms = <5>;
    bindings = <&kp LA(LS(LC(U)))>;
)

ZMK_BEHAVIOR(SNPST_REG, macro,
    wait-ms = <100>;
    tap-ms = <5>;
    bindings = <&kp LA(LS(LC(I)))>;
)

ZMK_BEHAVIOR(SNPST_VID, macro,
    wait-ms = <100>;
    tap-ms = <5>;
    bindings = <&kp LA(LS(LC(O)))>;
)

ZMK_BEHAVIOR(NV_DW, macro,
    wait-ms = <100>;
    tap-ms = <5>;
    bindings = <&kp LC(W) &kp J>;
)

ZMK_BEHAVIOR(NV_UW, macro,
    wait-ms = <100>;
    tap-ms = <5>;
    bindings = <&kp LC(W) &kp K>;
)

ZMK_BEHAVIOR(NV_RW, macro,
    wait-ms = <100>;
    tap-ms = <5>;
    bindings = <&kp LC(W) &kp L>;
)

ZMK_BEHAVIOR(NV_LW, macro,
    wait-ms = <100>;
    tap-ms = <5>;
    bindings = <&kp LC(W) &kp H>;
)

#define MEDIA_L  1
#define NAV_L    2
#define MOUSE_L  3
#define SYM_L    4
#define NUM_L    5
#define FN_L     6
#define SPCL_L   7
#define GAME_L   8
#define SAMPLE_L 9

#define MDA(key) &la MEDIA_L key
#define NAV(key) &la NAV_L   key
#define MSE(key) &la MOUSE_L key
#define SYM(key) &la SYM_L   key
#define NUM(key) &la NUM_L   key
#define FN(key)  &la FN_L    key

/ {
    conditional_layers {
        compatible = "zmk,conditional-layers";
        tri_layer {
            if-layers = <NAV_L MEDIA_L>;
            then-layer = <SPCL_L>;
        };
    };

    keymap {
        compatible = "zmk,keymap";

        qwerty {
            display-name = "QWERTY";
            bindings = <
// ╭────────────┬──────────────┬─────────────┬──────────────┬──────────────┬──────────────╮  ╭──────────────╮  ╭──────────────┬──────────────┬──────────────┬─────────────┬────────────────┬────────────╮
     &kp TAB      &kp Q          &kp W         &kp E          &kp R          &kp T             &NV_UW /*U*/     &kp Y          &kp U          &kp I          &kp O         &kp P            &none
// ├────────────┼──────────────┼─────────────┼──────────────┼──────────────┼──────────────┤  ├──────────────┤  ├──────────────┼──────────────┼──────────────┼─────────────┼────────────────┼────────────┤
     &kp ESC      &hml LGUI A    &hml LALT S   &hml LCTRL D   &hml LSHFT F   &kp G             &NV_DW /*D*/     &kp H          &hmr LSHFT J   &hmr LCTRL K   &hmr LALT L   &hmr LGUI SQT    &kp SEMI
// ├────────────┼──────────────┼─────────────┼──────────────┼──────────────┼──────────────┤  ├──────────────┤  ├──────────────┼──────────────┼──────────────┼─────────────┼────────────────┼────────────┤
     &caps_word   &kp Z          &kp X         &kp C          &kp V          &kp B             &NV_LW /*L*/     &kp N          &kp M          &kp COMMA      &kp DOT       &kp FSLH         &SNPST_PIC
// ╰────────────┴──────────────┼─────────────┼──────────────┼──────────────┼──────────────┤  ├──────────────┤  ├──────────────┼──────────────┼──────────────┼─────────────┴────────────────┴────────────╯
                                 CLPBRD        MDA(BSPC)      NAV(SPACE)     MSE(ENTER)        &NV_RW /*R*/     SYM(ENTER)     NUM(SPACE)     FN(DEL)
//                             ╰─────────────┴──────────────┴──────────────┴──────────────╯  ├──────────────┤  ╰──────────────┴──────────────┴──────────────╯
                                                                                               OPWD
//                                                                                           ╰──────────────╯
            >;

            label = "QWERTY";
            sensor-bindings = <&arrow_encoder>;
        };

        media {
            display-name = "MEDIA";

            bindings = <
// ╭───────────┬───────┬───────┬───────┬───────────┬───────╮  ╭───────╮  ╭────────────┬──────────────┬──────────────┬────────────┬───────┬───────────╮
     &kp LALT    &none   &none   &none   &none       &none      &none      &kp F13      &SNPST_PIC     &SNPST_REG     &SNPST_VID   &none   &kp LGUI
// ├───────────┼───────┼───────┼───────┼───────────┼───────┤  ├───────┤  ├────────────┼──────────────┼──────────────┼────────────┼───────┼───────────┤
     &kp LCTRL   &none   &none   &none   &none       &none      &none      &kp C_PREV   &kp C_VOL_DN   &kp C_VOL_UP   &kp C_NEXT   &none   &kp LCTRL
// ├───────────┼───────┼───────┼───────┼───────────┼───────┤  ├───────┤  ├────────────┼──────────────┼──────────────┼────────────┼───────┼───────────┤
     &none       &none   &none   &none   &none       &none      &none      &none        &none          &none          &none        &none   &kp LSHFT
// ╰───────────┴───────┼───────┼───────┼───────────┼───────┤  ├───────┤  ├────────────┼──────────────┼──────────────┼────────────┴───────┴───────────╯
                         &none   &none   &mo NAV_L   &none      &none      &kp C_STOP   &kp C_PP       &kp C_MUTE
//                     ╰───────┴───────┴───────────┴───────╯  ├───────┤  ╰────────────┴──────────────┴──────────────╯
                                                                &none
//                                                            ╰───────╯
            >;

            label = "MEDIA";
            sensor-bindings = <&inc_dec_kp C_VOLUME_UP C_VOLUME_DOWN>;
        };

        nav {
            display-name = "NAV";

            bindings = <
// ╭───────────┬────────┬────────┬─────────────┬────────┬────────╮  ╭───────╮  ╭────────────────┬────────────────┬──────────────┬─────────────────┬────────┬───────────╮
     &none       AR_1     AR_2     AR_3          AR_4     AR_5        &none      AR_6             AR_LW            AR_RW          &none             &none    &kp BSPC
// ├───────────┼────────┼────────┼─────────────┼────────┼────────┤  ├───────┤  ├────────────────┼────────────────┼──────────────┼─────────────────┼────────┼───────────┤
     AR_FSCR     &TMUX1   &TMUX2   &TMUX3        &TMUX4   &TMUX5      &none      &kp LEFT_ARROW   &kp DOWN_ARROW   &kp UP_ARROW   &kp RIGHT_ARROW   &TMUXS   &kp LCTRL
// ├───────────┼────────┼────────┼─────────────┼────────┼────────┤  ├───────┤  ├────────────────┼────────────────┼──────────────┼─────────────────┼────────┼───────────┤
     &none       LG_1     LG_2     LG_3          LG_4     LG_5        &none      &kp HOME         &kp PG_DN        &kp PG_UP      &kp END           &TMUXC   &kp LSHFT
// ╰───────────┴────────┼────────┼─────────────┼────────┼────────┤  ├───────┤  ├────────────────┼────────────────┼──────────────┼─────────────────┴────────┴───────────╯
                          &none    &mo MEDIA_L   &none    &none       &none      &kp LC(O)        &kp LC(I)        &none
//                      ╰────────┴─────────────┴────────┴────────╯  ├───────┤  ╰────────────────┴────────────────┴──────────────╯
                                                                      &none
//                                                                  ╰───────╯
               >;

            label = "NAV";
            sensor-bindings = <&scroll_encoder>;
        };

        mouse {
            display-name = "MOUSE";
            bindings = <
// ╭───────────┬───────┬───────┬───────┬───────┬───────╮  ╭───────╮  ╭────────────────────┬────────────────┬────────────────┬─────────────────────┬───────┬──────────────╮
     PD(SPACE)   PD(Q)   PD(W)   PD(E)   PD(R)   PD(T)      &none      &mmv MOVE_LEFT       &mmv MOVE_DOWN   &mmv MOVE_UP     &mmv MOVE_RIGHT       &none   &kp LA(BSPC)
// ├───────────┼───────┼───────┼───────┼───────┼───────┤  ├───────┤  ├────────────────────┼────────────────┼────────────────┼─────────────────────┼───────┼──────────────┤
     &kp LCTRL   PD(A)   PD(S)   PD(D)   PD(F)   PD(G)      &none      &kp LA(LEFT_ARROW)   &none            &none            &kp LA(RIGHT_ARROW)   &none   &kp LCTRL
// ├───────────┼───────┼───────┼───────┼───────┼───────┤  ├───────┤  ├────────────────────┼────────────────┼────────────────┼─────────────────────┼───────┼──────────────┤
     &none       &none   &none   &none   &none   &none      &none      &msc SCRL_LEFT       &msc SCRL_UP     &msc SCRL_DOWN   &msc SCRL_RIGHT       &none   &kp LSHFT
// ╰───────────┴───────┼───────┼───────┼───────┼───────┤  ├───────┤  ├────────────────────┼────────────────┼────────────────┼─────────────────────┴───────┴──────────────╯
                         &none   &none   &none   &none      &none      &kp LA(BSPC)         &mkp LCLK        &mkp RCLK
//                     ╰───────┴───────┴───────┴───────╯  ├───────┤  ╰────────────────────┴────────────────┴────────────────╯
                                                            &none
//                                                        ╰───────╯
            >;

            label = "MOUSE";
            sensor-bindings = <&scroll_encoder>;
        };

        sym {
            display-name = "SYM";

            bindings = <
// ╭───────────┬───────────┬──────────┬───────────┬───────────┬───────────╮  ╭───────╮  ╭────────────────────┬────────────┬───────┬─────────────────────┬───────┬───────────╮
     &kp LALT    &kp LBRC    &kp EXCL   &kp AT      &kp HASH    &kp RBRC       &none      &none                &none        &none   &none                 &none   &kp BSPC
// ├───────────┼───────────┼──────────┼───────────┼───────────┼───────────┤  ├───────┤  ├────────────────────┼────────────┼───────┼─────────────────────┼───────┼───────────┤
     &kp LCTRL   &kp COLON   &kp DLLR   &kp PRCNT   &kp CARET   &kp PLUS       &none      &kp LA(LEFT_ARROW)   &none        &none   &kp LA(RIGHT_ARROW)   &none   &kp LGUI
// ├───────────┼───────────┼──────────┼───────────┼───────────┼───────────┤  ├───────┤  ├────────────────────┼────────────┼───────┼─────────────────────┼───────┼───────────┤
     &none       &kp TILDE   &kp AMPS   &kp STAR    &kp LPAR    &kp PIPE       &none      &none                &none        &none   &none                 &none   &kp LSHFT
// ╰───────────┴───────────┼──────────┼───────────┼───────────┼───────────┤  ├───────┤  ├────────────────────┼────────────┼───────┼─────────────────────┴───────┴───────────╯
                             &none      &kp LPAR    &kp RPAR    &kp UNDER      &none      &none                &none        &none
//                         ╰──────────┴───────────┴───────────┴───────────╯  ├───────┤  ╰────────────────────┴────────────┴───────╯
                                                                               &none
//                                                                           ╰───────╯
            >;

            label = "SYM";
            sensor-bindings = <&scroll_encoder>;
        };

        num {
            display-name = "NUM";

            bindings = <
// ╭───────────┬───────────┬────────┬─────────┬────────┬───────────╮  ╭───────╮  ╭────────┬───────────┬──────────┬──────────┬───────────┬───────────╮
     &kp LALT    &kp LBKT    &kp N1   &kp N2    &kp N3   &kp RBKT       &none      &trans   &trans      &trans     &trans     &trans      &kp BSPC
// ├───────────┼───────────┼────────┼─────────┼────────┼───────────┤  ├───────┤  ├────────┼───────────┼──────────┼──────────┼───────────┼───────────┤
     &kp LCTRL   &kp SEMI    &kp N4   &kp N5    &kp N6   &kp EQUAL      &none      &trans   &kp LCTRL   &kp LALT   &kp LGUI   &kp LSHFT   &kp LGUI
// ├───────────┼───────────┼────────┼─────────┼────────┼───────────┤  ├───────┤  ├────────┼───────────┼──────────┼──────────┼───────────┼───────────┤
     &none       &kp GRAVE   &kp N7   &kp N8    &kp N9   &kp BSLH       &none      &trans   &trans      &trans     &trans     &trans      &kp LSHFT
// ╰───────────┴───────────┼────────┼─────────┼────────┼───────────┤  ├───────┤  ├────────┼───────────┼──────────┼──────────┴───────────┴───────────╯
                             &none    &kp DOT   &kp N0   &kp MINUS      &none      &trans   &trans      &trans
//                         ╰────────┴─────────┴────────┴───────────╯  ├───────┤  ╰────────┴───────────┴──────────╯
                                                                        &none
//                                                                    ╰───────╯
            >;

            label = "NUM";
            sensor-bindings = <&scroll_encoder>;
        };

        fn {
            display-name = "Fn";

            bindings = <
// ╭─────────────┬─────────┬────────────┬────────┬───────────┬─────────╮  ╭───────╮  ╭────────────┬────────────┬───────┬───────┬─────────────────┬─────────────╮
     &none         &kp F10   &kp F1       &kp F2   &kp F3      &none        &none      &bt BT_PRV   &bt BT_NXT   &none   &none   &rgb_ug RGB_OFF   MAC_SLP
// ├─────────────┼─────────┼────────────┼────────┼───────────┼─────────┤  ├───────┤  ├────────────┼────────────┼───────┼───────┼─────────────────┼─────────────┤
     &none         &kp F11   &kp F4       &kp F5   &kp F6      AR_ACC       &none      &none        &none        &none   &none   &rgb_ug RGB_ON    &none
// ├─────────────┼─────────┼────────────┼────────┼───────────┼─────────┤  ├───────┤  ├────────────┼────────────┼───────┼───────┼─────────────────┼─────────────┤
     &bootloader   &kp F12   &kp F7       &kp F8   &kp F9      AR_TIL       &none      &none        &none        &none   &none   &sys_reset        &bootloader
// ╰─────────────┴─────────┼────────────┼────────┼───────────┼─────────┤  ├───────┤  ├────────────┼────────────┼───────┼───────┴─────────────────┴─────────────╯
                             &bt BT_CLR   &none    &kp SPACE   &kp TAB      &none      &none        &none        &none
//                         ╰────────────┴────────┴───────────┴─────────╯  ├───────┤  ╰────────────┴────────────┴───────╯
                                                                            &none
//                                                                        ╰───────╯
            >;

            label = "Fn";
            sensor-bindings = <&scroll_encoder>;
        };

        special {
            display-name = "SPECIAL";

            bindings = <
// ╭───────┬───────┬───────┬───────┬───────┬───────╮  ╭───────╮  ╭────────────────────┬───────┬───────┬─────────────────────┬───────┬──────────────╮
     &none   &none   &none   &none   &none   &none      &none      &none                &none   &none   &none                 &none   &kp LA(BSPC)
// ├───────┼───────┼───────┼───────┼───────┼───────┤  ├───────┤  ├────────────────────┼───────┼───────┼─────────────────────┼───────┼──────────────┤
     &none   &none   &none   &none   &none   &none      &none      &kp LA(LEFT_ARROW)   &none   &none   &kp LA(RIGHT_ARROW)   &none   &none
// ├───────┼───────┼───────┼───────┼───────┼───────┤  ├───────┤  ├────────────────────┼───────┼───────┼─────────────────────┼───────┼──────────────┤
     &none   &none   &none   &none   &none   &none      &none      &none                &none   &none   &none                 &none   &none
// ╰───────┴───────┼───────┼───────┼───────┼───────┤  ├───────┤  ├────────────────────┼───────┼───────┼─────────────────────┴───────┴──────────────╯
                     &none   &none   &none   &none      &none      &none                &none   &none
//                 ╰───────┴───────┴───────┴───────╯  ├───────┤  ╰────────────────────┴───────┴───────╯
                                                        &none
//                                                    ╰───────╯
            >;

            label = "SPECIAL";
            sensor-bindings = <&scroll_encoder>;
        };

        game {
            display-name = "GAME";
            bindings = <
// ╭────────────┬───────┬────────┬───────────┬───────────┬───────────╮  ╭────────────╮  ╭───────────┬───────────┬───────────┬─────────┬──────────┬────────────╮
     &kp TAB      &kp Q   &kp W    &kp E       &kp R       &kp T          OPWD /*U*/      &kp Y       &kp U       &kp I       &kp O     &kp P      &tog GAME_L
// ├────────────┼───────┼────────┼───────────┼───────────┼───────────┤  ├────────────┤  ├───────────┼───────────┼───────────┼─────────┼──────────┼────────────┤
     &kp ESC      &kp A   &kp S    &kp D       &kp F       &kp G          OPWD /*D*/      &kp H       &kp J       &kp K       &kp L     &kp SQT    &kp SEMI
// ├────────────┼───────┼────────┼───────────┼───────────┼───────────┤  ├────────────┤  ├───────────┼───────────┼───────────┼─────────┼──────────┼────────────┤
     &kp LCTRL    &kp Z   &kp X    &kp C       &kp V       &kp B          OPWD /*L*/      &kp N       &kp M       &kp COMMA   &kp DOT   &kp FSLH   &SNPST_PIC
// ╰────────────┴───────┼────────┼───────────┼───────────┼───────────┤  ├────────────┤  ├───────────┼───────────┼───────────┼─────────┴──────────┴────────────╯
                          CLPBRD   &kp LSHFT   &kp SPACE   &kp ENTER      OPWD /*R*/      &kp ENTER   &kp SPACE   &kp LALT
//                      ╰────────┴───────────┴───────────┴───────────╯  ├────────────┤  ╰───────────┴───────────┴───────────╯
                                                                          OPWD
//                                                                      ╰────────────╯
            >;

            label = "GAME";
            sensor-bindings = <&arrow_encoder>;
        };

        sample {
            display-name = "SAMPLE";

            bindings = <
// ╭───────┬───────┬───────┬───────┬───────┬───────╮  ╭───────╮  ╭───────┬───────┬───────┬───────┬───────┬───────╮
     &none   &none   &none   &none   &none   &none      &none      &none   &none   &none   &none   &none   &none
// ├───────┼───────┼───────┼───────┼───────┼───────┤  ├───────┤  ├───────┼───────┼───────┼───────┼───────┼───────┤
     &none   &none   &none   &none   &none   &none      &none      &none   &none   &none   &none   &none   &none
// ├───────┼───────┼───────┼───────┼───────┼───────┤  ├───────┤  ├───────┼───────┼───────┼───────┼───────┼───────┤
     &none   &none   &none   &none   &none   &none      &none      &none   &none   &none   &none   &none   &none
// ╰───────┴───────┼───────┼───────┼───────┼───────┤  ├───────┤  ├───────┼───────┼───────┼───────┴───────┴───────╯
                     &none   &none   &none   &none      &none      &none   &none   &none
//                 ╰───────┴───────┴───────┴───────╯  ├───────┤  ╰───────┴───────┴───────╯
                                                        &none
//                                                    ╰───────╯
            >;

            label = "SAMPLE";
            sensor-bindings = <&scroll_encoder>;
        };
	};
};


